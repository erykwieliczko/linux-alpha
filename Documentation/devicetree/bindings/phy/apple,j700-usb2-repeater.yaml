## Documentation/devicetree/bindings/phy/apple,j700-usb2-repeater.yaml
```yaml
# SPDX-License-Identifier: (GPL-2.0-only OR BSD-2-Clause)
%YAML 1.2
---
$id: http://devicetree.org/schemas/phy/apple,j700-usb2-repeater.yaml#
$schema: http://devicetree.org/meta-schemas/core.yaml#

title: Apple J700 USB2 repeater and fixed hub supplier

maintainers:
  - Eryk Wieliczko <eryk@wieliczko.ninja>

description: >
  J700 places a TICD2E22 repeater before a shared VL122 USB2 hub. This board
  supplier configures the repeater over byte-data I2C and owns GPIO142 for
  the shared hub lifetime. It must be initialized before the SoC USB2 PHY
  starts. It does not control Type-C attachment, VBUS, or debug routing.
  The initial retained-power profile holds the GPIO physically low without
  a reset pulse; suspend/resume and cold-start policy are not described here.

properties:
  compatible:
    const: apple,j700-usb2-repeater

  reg:
    maxItems: 1

  '#phy-cells':
    const: 0

  hub-hold-gpios:
    maxItems: 1
    description: Shared hub output, active-high descriptor held logically low.

required:
  - compatible
  - reg
  - '#phy-cells'
  - hub-hold-gpios

additionalProperties: false
```

## Documentation/devicetree/bindings/usb/apple,dwc3.yaml
```yaml
# SPDX-License-Identifier: (GPL-2.0-only OR BSD-2-Clause)
%YAML 1.2
---
$id: http://devicetree.org/schemas/usb/apple,dwc3.yaml#
$schema: http://devicetree.org/meta-schemas/core.yaml#

title: Apple Silicon DWC3 USB controller

maintainers:
  - Sven Peter <sven@kernel.org>

description:
  Apple Silicon SoCs use a Synopsys DesignWare DWC3 based controller for each of
  their Type-C ports.

allOf:
  - $ref: snps,dwc3-common.yaml#
  - if:
      required:
        - apple,usb2-fixed-host
    then:
      properties:
        compatible:
          contains:
            const: apple,t8140-dwc3
        dr_mode:
          const: host
        maximum-speed:
          const: high-speed
      required:
        - dr_mode
        - maximum-speed
    else:
      required:
        - usb-role-switch
  - if:
      not:
        properties:
          compatible:
            contains:
              const: apple,t8132-dwc3
    then:
      required:
        - power-domains

properties:
  compatible:
    oneOf:
      - items:
          - enum:
              - apple,t6000-dwc3
              - apple,t6020-dwc3
              - apple,t8112-dwc3
              - apple,t8140-dwc3
          - const: apple,t8103-dwc3
      - enum:
          - apple,t8103-dwc3
          - apple,t8132-dwc3

  reg:
    items:
      - description: Core DWC3 region
      - description: Apple-specific DWC3 region

  reg-names:
    items:
      - const: dwc3-core
      - const: dwc3-apple

  interrupts:
    maxItems: 1

  iommus:
    maxItems: 2

  resets:
    maxItems: 1

  power-domains:
    maxItems: 1

  apple,usb2-fixed-host:
    type: boolean
    description: >
      Start the J700 shared onboard USB2 hub in host mode at probe, independently
      of Type-C events. PHY and repeater readiness remain required dependencies.

  usb2-role-inputs:
    type: object
    description: >
      Optional front-only J700 attachment input. Index 1 identifies the front
      connector; the rear debug connector has no protocol owner in this profile.
    properties:
      '#address-cells':
        const: 1
      '#size-cells':
        const: 0
      role-switch@1:
        type: object
        properties:
          reg:
            const: 1
          usb-role-switch: true
          port:
            $ref: /schemas/graph.yaml#/properties/port
        required:
          - reg
          - usb-role-switch
          - port
        additionalProperties: false
    required:
      - '#address-cells'
      - '#size-cells'
      - role-switch@1
    additionalProperties: false

required:
  - compatible
  - reg
  - reg-names
  - interrupts
  - iommus
  - resets

unevaluatedProperties: false

examples:
  - |
    #include <dt-bindings/interrupt-controller/apple-aic.h>
    #include <dt-bindings/interrupt-controller/irq.h>

    usb@82280000 {
      compatible = "apple,t8103-dwc3";
      reg = <0x82280000 0xcd00>, <0x8228cd00 0x3200>;
      reg-names = "dwc3-core", "dwc3-apple";
      interrupts = <AIC_IRQ 777 IRQ_TYPE_LEVEL_HIGH>;
      iommus = <&dwc3_0_dart_0 0>, <&dwc3_0_dart_1 1>;

      power-domains = <&ps_atc0_usb>;
      resets = <&atcphy0>;

      usb-role-switch;
    };
```
